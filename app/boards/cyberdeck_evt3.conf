## app/boards/cyberdeck_evt3.conf
```kconfig
CONFIG_COUNTER=y

CONFIG_GPIO=y
CONFIG_I2C=y
CONFIG_PWM=y
CONFIG_LED=y
CONFIG_LED_GPIO=y
CONFIG_LED_PWM=y
CONFIG_LED_STRIP=y
CONFIG_WS2812_STRIP_GPIO=y
CONFIG_DISPLAY_INIT_PRIORITY=95

CONFIG_USB_DEVICE_STACK=y
CONFIG_USB_DEVICE_INITIALIZE_AT_BOOT=y
CONFIG_USB_DEVICE_PRODUCT="Cyberdeck EVT3 HWV"
CONFIG_USB_DEVICE_VID=0x0EEA
CONFIG_USB_DEVICE_PID=0x0003
CONFIG_USB_CDC_ACM=y
CONFIG_UART_INTERRUPT_DRIVEN=y
CONFIG_UART_LINE_CTRL=y

CONFIG_LSM6DSO_TRIGGER_GLOBAL_THREAD=y
CONFIG_REBOOT=y

CONFIG_MAIN_STACK_SIZE=4096
CONFIG_SHELL_STACK_SIZE=4096
CONFIG_HEAP_MEM_POOL_SIZE=16384
```

## app/sample.yaml
```yaml
sample:
  description: Pebble HWV
  name: pebble-hwv
common:
  build_only: true
  integration_platforms:
    - asterix
    - cyberdeck_evt3
tests:
  app.default: {}
```

## boards/coredevices/cyberdeck_evt3/board.yml
```yaml
boards:
- name: cyberdeck_evt3
  vendor: coredevices
  socs:
    - name: nrf52840
```

## drivers/display/Kconfig
```kconfig
menuconfig DISPLAY_EXTERNAL
	bool "Display drivers (external)"
	default y if DISPLAY

if DISPLAY_EXTERNAL

rsource "Kconfig.ls013b7dh05"
rsource "Kconfig.ls013b7dh01"

endif # DISPLAY_EXTERNAL
```

## drivers/display/Kconfig.ls013b7dh01
```kconfig
config DISPLAY_LS013B7DH01
	bool "Sharp LS013B7DH01 display"
	depends on DT_HAS_SHARP_LS013B7DH01_ENABLED
	select SPI
	select GPIO
	select LED
	select PWM
	default y
	help
	  Driver for the Sharp LS013B7DH01 400x240 memory LCD.
```

## dts/bindings/display/sharp,ls013b7dh01.yaml
```yaml
description: Sharp LS013B7DH01 400x240 memory LCD module

compatible: "sharp,ls013b7dh01"

include: ["display-controller.yaml", "spi-device.yaml"]

properties:
  disp-gpios:
    type: phandle-array
    description: Optional dedicated display ON/OFF GPIO; omit when power is shared

  pwms:
    type: phandle-array
    required: true
    description: Display EXTCOMIN PWM

  pwm-names:
    type: string-array
    required: true
    description: Display EXTCOMIN PWM names

  backlight:
    type: phandle
    required: true
    description: Backlight LED controller
```

## dts/bindings/input/coredevices,ofn83.yaml
```yaml
description: 83_OFN optical navigation controller

compatible: "coredevices,ofn83"

include: i2c-device.yaml

properties:
  int-gpios:
    type: phandle-array
    required: true
    description: Active-low motion interrupt
  reset-gpios:
    type: phandle-array
    required: true
    description: Active-low reset
  shutdown-gpios:
    type: phandle-array
    required: true
    description: Active-high shutdown
```

## dts/bindings/input/coredevices,tca8418.yaml
```yaml
description: Core Devices TCA8418 keyboard matrix controller

compatible: "coredevices,tca8418"

include: i2c-device.yaml

properties:
  int-gpios:
    type: phandle-array
    required: true
    description: Active-low keyboard interrupt
```

## dts/bindings/misc/coredevices,cyberdeck-hwv.yaml
```yaml
description: Cyberdeck EVT3 nRF hardware-validation controls

compatible: "coredevices,cyberdeck-hwv"

properties:
  peripheral-power-gpios:
    type: phandle-array
    required: true
  lcd-select-gpios:
    type: phandle-array
    required: true
  ec-key-gpios:
    type: phandle-array
    required: true
```
